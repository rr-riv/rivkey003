#include <physical_layouts.dtsi>

/ {
    physical_layout0: physical_layout0 {
        compatible = "zmk,physical-layout";
        display-name = "Layout";
        keys = <
            /* ここはあなたのレイアウトに合わせて後で調整可能 */
            &key_physical_attrs 100 100 0 0 0 0 0
            /* ...（必要なら後で追加） */
        >;
    };
};
