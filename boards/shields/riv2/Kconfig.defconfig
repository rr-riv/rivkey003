## boards/shields/riv2/Kconfig.defconfig
```kconfig
if SHIELD_RIV2_LEFT

config ZMK_KEYBOARD_NAME
    default "riv2"

endif

if SHIELD_RIV2_LEFT || SHIELD_RIV2_RIGHT

config ZMK_SPLIT
    default y

endif
```

## boards/shields/riv2/Kconfig.shield
```kconfig
config SHIELD_RIV2_LEFT
    def_bool $(shields_list_contains,riv2_left)
config SHIELD_RIV2_RIGHT
    def_bool $(shields_list_contains,riv2_right)
```
